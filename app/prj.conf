## CMakeLists.txt
```
# CMakeLists.txt — Zephyr application build entry point
# This file is the root of the Zephyr build system for this application.
# It locates the Zephyr SDK, defines the project, and specifies source files.

cmake_minimum_required(VERSION 3.20.0)

# Find Zephyr SDK — ZEPHYR_BASE must be set by west or manually
find_package(Zephyr REQUIRED HINTS $ENV{ZEPHYR_BASE})

# Project name (used in build artifacts)
project(rw61x_template)

# Add application source files
target_sources(app PRIVATE src/main.c)
```

## west.yml
```
# west.yml — T-topology: this repo IS the manifest repo
# Run: west init -l .  (if initializing from existing repo)
# Or:  west init -m <your-repo-url>
#      then clone this repo at workspace root
manifest:
  remotes:
    - name: nxp-zephyr
      url-base: https://github.com/nxp-zephyr
  projects:
    - name: nxp-zsdk
      remote: nxp-zephyr
      revision: nxp-v4.3-branch
      import: true
  self:
    path: app
```

## prj.conf
```kconfig
# prj.conf — Base Kconfig for RW61x Zephyr Template
#
# This file contains the minimal configuration required for:
# - UART console output
# - Logging subsystem at INFO level
# - UART backend for logs
#
# To add debug logging, use: west build -b frdm_rw612 app/ -- -DEXTRA_CONF_FILE=conf/debug.conf
# To add WiFi support, use: west build -b frdm_rw612 app/ -- -DEXTRA_CONF_FILE=conf/wifi.conf
# To combine multiple fragments: -DEXTRA_CONF_FILE="conf/debug.conf;conf/wifi.conf"

# Console configuration
CONFIG_CONSOLE=y
CONFIG_UART_CONSOLE=y

# Logging subsystem
CONFIG_LOG=y
CONFIG_LOG_DEFAULT_LEVEL=3
CONFIG_LOG_BACKEND_UART=y
CONFIG_LOG_PROCESS_THREAD_SLEEP_MS=10
```

## boards/frdm_rw612.overlay
```dts
/*
 * frdm_rw612.overlay — Device Tree Overlay for FRDM-RW612 Board
 *
 * This overlay configures board-specific hardware settings:
 * - Sets flexcomm3 as the console UART
 * - Sets flexcomm3 as the shell UART
 *
 * Zephyr automatically applies this overlay when building for frdm_rw612 board.
 * The file name must match the board target: <board_name>.overlay
 *
 * For EVK-RW612 board, rename this file to: rw612_evk.overlay
 */

/ {
    chosen {
        zephyr,console = &flexcomm3;
        zephyr,shell-uart = &flexcomm3;
    };
};
```

## src/main.c
```c
/*
 * main.c — RW61x Zephyr Template Application
 *
 * Minimal application demonstrating:
 * - Zephyr kernel initialization
 * - Logging subsystem usage (LOG_INF, LOG_DBG)
 * - Board configuration via CONFIG_BOARD
 *
 * This is a template starting point. Extend with WiFi, BLE, or other features.
 */

#include <zephyr/kernel.h>
#include <zephyr/logging/log.h>

// Register this file as a logging module with INFO level
LOG_MODULE_REGISTER(main, LOG_LEVEL_INF);

int main(void)
{
    LOG_INF("RW61x Zephyr template v1.0");
    LOG_INF("Board: %s", CONFIG_BOARD);
    LOG_DBG("Debug logging enabled (if LOG_DEFAULT_LEVEL >= 4)");

    // Main application loop
    while (1) {
        k_sleep(K_SECONDS(5));
        LOG_INF("Heartbeat");
    }

    return 0;
}
```
